#include "sm1_s905x3_2g_1gbit.dts"
#include "coreelec_meson_fb_4g.dtsi"

/{
	coreelec-dt-id = "sm1_s905x3_4g_1gbit";

	memory@00000000 {
		linux,usable-memory = <0x0 0x100000 0x0 0xf0800000>;
		/* 0xf5700000 used in stock android dtb changed
		to 0xf0800000 to fix some 4G generic devices
		not able to boot with the default value.*/
	};
};
