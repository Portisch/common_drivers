#include "sc2_s905x4_buzztv_x5_2g.dts"
#include "coreelec_fb_4g.dtsi"

/ {
	amlogic-dt-id = "sc2_s905x4_ah212-Eth-4g";
	coreelec-dt-id = "sc2_s905x4_buzztv_x5_4g";

	memory@00000000 {
		linux,usable-memory = <0x0 0x000000 0x0 0xf1000000>;
	};
};
